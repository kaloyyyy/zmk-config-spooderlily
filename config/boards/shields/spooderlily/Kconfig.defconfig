## config/boards/shields/spooderlily/Kconfig.defconfig
```kconfig
# Copyright (c) 2021 The ZMK Contributors
# SPDX-License-Identifier: MIT
if SHIELD_SPOODERLILY_LEFT

config ZMK_KEYBOARD_NAME
    default "spooderlily"

config ZMK_SPLIT_ROLE_CENTRAL
    default y

endif

if SHIELD_SPOODERLILY_LEFT || SHIELD_SPOODERLILY_RIGHT

config ZMK_SPLIT
    default y

endif
```

## config/boards/shields/spooderlily/Kconfig.shield
```kconfig
# Copyright (c) 2020 Pete Johanson
# SPDX-License-Identifier: MIT

config SHIELD_SPOODERLILY_LEFT
    def_bool $(shields_list_contains,spooderlily_left)

config SHIELD_SPOODERLILY_RIGHT
    def_bool $(shields_list_contains,spooderlily_right)
```
